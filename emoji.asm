#include		<PIC16F877A.INC>
DEG1	EQU		0X0020
DEG2	EQU		0X0021
	ORG				0X0000
	GOTO			AYAR
AYAR
	BSF				STATUS,RP0
	CLRF			TRISB
	CLRF			TRISC
	CLRF			TRISD
	BCF				STATUS,RP0
	GOTO			MAIN
MAIN
	DONGU
	CALL			GECIKME
		MOVLW			0X01
		MOVWF			PORTC
		MOVLW			0X7F
		MOVWF			PORTB
		MOVLW			0X7F
		MOVWF			PORTD
		CALL			GECIKME
		NOP
		MOVLW			0X02
		MOVWF			PORTC
		MOVLW			0X71
		MOVWF			PORTB
		MOVLW			0X71
		MOVWF			PORTD
		CALL			GECIKME
		NOP
		MOVLW			0X04
		MOVWF			PORTC
		MOVLW			0XE0
		MOVWF			PORTB
		MOVLW			0XE0
		MOVWF			PORTD
		CALL			GECIKME
		NOP
		MOVLW			0X08
		MOVWF			PORTC
		MOVLW			0XC0
		MOVWF			PORTB
		MOVLW			0XC0
		MOVWF			PORTD
		CALL			GECIKME
		NOP
		MOVLW			0X10
		MOVWF			PORTC
		MOVLW			0X81
		MOVWF			PORTB
		MOVLW			0X81
		MOVWF			PORTD
		CALL			GECIKME
		CALL			GECIKME
		
	GOTO			DONGU



GECIKME
	NOP
	NOP
	NOP
	MOVLW			0XC0
	MOVWF			DEG1
	TEKRAR
		MOVLW			0X40
		MOVWF			DEG2
		GECIK
			DECFSZ			DEG2
			GOTO			GECIK
			DECFSZ			DEG1
			GOTO			TEKRAR
			RETURN


END